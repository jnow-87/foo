/**
 * Copyright (C) 2024 Jan Nowotsch
 * Author Jan Nowotsch	<jan.nowotsch@gmail.com>
 *
 * Released under the terms of the GNU GPL v2.0
 */



#include <memory.dts>


// TODO missing tests
//	- type: asserts
//	- type: ilists
//	- arithmetic: using ilists
//	- data type limits
//	- different integer sizes

devicetype{
	string compatible = "default";
	int8 i = 1;
	addr p = 0x10;
} test_dev;



/* test included type */
flash = memory(base=0x10000000, size=2097152);

/* test type default attributes */
def-0 = test_dev();
def-1 = test_dev(compatible="def-1");
def-2 = test_dev(i=2);
def-3 = test_dev(p=0x20);
def-4 = test_dev(compatible="def-4", i=3, p=0x30);

/* test trailing comma in node arguments */
trailing-comma = test_dev(i=3,);

/* test attribute updates */
updates = test_dev(compatible="initial", i=1, p=0x1);

updates.compatible = "reset";
updates.compatible += "-add";

updates.i = 10;
updates.p = 0x20;
updates.p += (++updates.i);
updates.i += 2 + 3;
updates.p++;

update-consumer = test_dev(
	i = (++updates.i),
	p = (updates.i++),
);

/* test arithmetics */
donor = test_dev(compatible="donation0", i=42, p=0xbe00);

arith-const = test_dev(
	compatible = "some" + "-" + "arith",
	i = 1 + 2 + 3,
	p = 0xb000 + 0xe00 + 0xe0 + 0xf,
);

ref-bare = test_dev(
	compatible = donor.compatible,
	i = donor.i,
	p = donor.p,
);

arith-ref = test_dev(
	donor-child = test_dev(compatible="donation1", i=1, p=0xef),

	compatible = "pre," + donor.compatible + "-arith-" + donor-child.compatible,
	i = 1 + donor.i + 2 + donor-child.i,
	p = 0x1 + donor-child.p + donor.p + 0x1,
);
