## driver/ssd1306/Kconfig
```kconfig
#
# Copyright (C) 2022 Jan Nowotsch
# Author Jan Nowotsch	<jan.nowotsch@gmail.com>
#
# Released under the terms of the GNU GPL v2.0
#



config DRIVER_SSD1306
	bool "sSD1306 i2c display"
	select DRIVER_I2C
```

## driver/term/Kconfig
```kconfig
#
# Copyright (C) 2018 Jan Nowotsch
# Author Jan Nowotsch	<jan.nowotsch@gmail.com>
#
# Released under the terms of the GNU GPL v2.0
#



menuconfig DRIVER_TERM
	bool "Terminal driver"
	select KERNEL_DEVFS
	select KERNEL_SIGNAL
	select KERNEL_INTTASK
	select SYS_RINGBUFFER
	select DRIVER_UART

if DRIVER_TERM
	config TERM_RXBUF_SIZE
		int "Rx buffer size"
		default 16
endif # DRIVER_TERM
```

## driver/uart/Kconfig
```kconfig
#
# Copyright (C) 2017 Jan Nowotsch
# Author Jan Nowotsch	<jan.nowotsch@gmail.com>
#
# Released under the terms of the GNU GPL v2.0
#



config DRIVER_UART
	bool "UART driver"
```

## driver/vram/Kconfig
```kconfig
#
# Copyright (C) 2022 Jan Nowotsch
# Author Jan Nowotsch	<jan.nowotsch@gmail.com>
#
# Released under the terms of the GNU GPL v2.0
#



menuconfig DRIVER_VRAM
	bool "video ram"

if DRIVER_VRAM
	config VRAM_RAW
		bool "devfs device driver"
		select KERNEL_DEVFS

	config VRAM_TERM
		bool "terminal driver"
		select FONTS
endif # DRIVER_VRAM
```

## driver/x11/Kconfig
```kconfig
#
# Copyright (C) 2022 Jan Nowotsch
# Author Jan Nowotsch	<jan.nowotsch@gmail.com>
#
# Released under the terms of the GNU GPL v2.0
#



config DRIVER_X11
	bool "x11 display"
```

## driver/x86/Kconfig
```kconfig
#
# Copyright (C) 2022 Jan Nowotsch
# Author Jan Nowotsch	<jan.nowotsch@gmail.com>
#
# Released under the terms of the GNU GPL v2.0
#


#
# gpio
#
config X86_GPIO
	bool "gpio driver"

#
# i2c
#
config X86_I2C
	bool "i2c driver"
	select DRIVER_BRIDGE
	select BRIDGE_I2C_DEV

#
# uart
#
config X86_UART
	bool "uart driver"
```

## init/Kconfig
```kconfig
#
# Copyright (C) 2018 Jan Nowotsch
# Author Jan Nowotsch	<jan.nowotsch@gmail.com>
#
# Released under the terms of the GNU GPL v2.0
#



menu "shell"
source init/shell/Kconfig
endmenu

menu "hidden"
	visible if 0
	config INIT_SHELL
		bool "shell"
		select LIB_READLINE
		select READLINE_HISTORY
		default y
endmenu
```

## init/shell/Kconfig
```kconfig
#
# Copyright (C) 2018 Jan Nowotsch
# Author Jan Nowotsch	<jan.nowotsch@gmail.com>
#
# Released under the terms of the GNU GPL v2.0
#



menu "commands"
	config INIT_HELP
		bool "help"

	config INIT_CD
		bool "cd"

	config INIT_LS
		bool "ls"

	config INIT_ECHO
		bool "echo"
		select LIB_GETOPT

	config INIT_CAT
		bool "cat"
		select LIB_GETOPT

	config INIT_MKDIR
		bool "mkdir"

	config INIT_RM
		bool "rm"

	config INIT_EXIT
		bool "exit"

	config INIT_SLEEP
		bool "sleep"

	config INIT_PINSAMPLER
		bool "pinsampler"
		select SYS_RINGBUFFER

	config INIT_PWMCTRL
		bool "pwmctrl"

	config INIT_I2CCFG
		bool "i2ccfg"

	config INIT_ETHERNET
		bool "ethernet"
		select LIB_GETOPT

	config INIT_GFXDEMO
		bool "gfx demo"
		select LIB_GFX

	config INIT_SENSORCAT
		bool "sensorcat"

	config INIT_TEST
		bool "test"
		select LIB_GETOPT

	config INIT_TEST_UNIT
		bool "include unit tests"
		depends on INIT_TEST
endmenu

config LINE_MAX
	int "max. length of input lines"
	default 32	if AVR
	default 256
```

## kernel/Kconfig
```kconfig
#
# Copyright (C) 2016 Jan Nowotsch
# Author Jan Nowotsch	<jan.nowotsch@gmail.com>
#
# Released under the terms of the GNU GPL v2.0
#



#
# kernel basics
#
# {{{
config KERNEL_SMP
	bool "build an smp system"
	default n

config KERNEL_LOG
	bool "kernel log"

config KERNEL_LOG_SIZE
	int "kernel log buffer size"
	depends on KERNEL_LOG
	default 10

config KERNEL_LOG_INIT
	bool "print kernel init messages"
	depends on KERNEL_LOG
	select KERNEL_LOG_INFO
	select KERNEL_LOG_WARN

config KERNEL_LOG_FATAL
	bool "print kernel FATAL messages"
	depends on KERNEL_LOG

config KERNEL_LOG_WARN
	bool "print kernel WARNING messages"
	depends on KERNEL_LOG

config KERNEL_LOG_INFO
	bool "print kernel INFO messages"
	depends on KERNEL_LOG

menu "hidden"
	visible if 0

	config KERNEL_NO_VIRT_MEM
		bool "kernel virtual memory support"
		default n

	config KERNEL_VIRT_MEM
		bool "kernel virtual memory support"
		default n	if KERNEL_NO_VIRT_MEM
		default y

	config KERNEL_SIGNAL
		bool "kernel signal support"
		select KERNEL_TIMER
		default n

	config KERNEL_INTTASK
		bool "kernel interrupt tasks"
		select KERNEL_SIGNAL
		default n

	config KERNEL_KTASK_QUEUE
		bool "ktask dependency queue"
		default n

	config KERNEL_LOG_DEBUG
		bool "print kernel DEBUG messages"
		select KERNEL_LOG
		default n

	config KERNEL_TIMER
		bool "timer"
		default n
endmenu
# }}}

#
# kernel memory layout
#
menu "memory configuration"
	source "kernel/memory/Kconfig"
endmenu

#
# system calls
#
# {{{
menu "system calls"
	config SC_DEBUG
		bool "global system call debug"
		depends on KERNEL_SYSCALL
		select KERNEL_LOG_DEBUG
		default n

	config SC_FILESYSTEM
		bool "file system"
		select KERNEL_SYSCALL
		select SC_DYNMEM
		select LIB_MUTEX
		default y
		help
			File system syscalls such as open, close, read, write.

	config SC_FILESYSTEM_DEBUG
		bool "file system debug messages"
		depends on SC_FILESYSTEM
		select KERNEL_LOG_DEBUG
		default n

	config SC_DYNMEM
		bool "dynamic memory"
		select KERNEL_SYSCALL
		select LIB_MUTEX
		default y
		help
			This includes malloc and free.

	config SC_DYNMEM_DEBUG
		bool "dynamic memory debug messages"
		depends on SC_DYNMEM
		select KERNEL_LOG_DEBUG
		select PRINTF_SIZET
		default n

	config SC_SCHED
		bool "scheduler, process and thread control"
		select KERNEL_SYSCALL
		select SC_SIGNAL
		default y
		help
			Syscalls for process and thread creation and control as well as scheduler calls.

	config SC_SCHED_DEBUG
		bool "scheduler, process and thread control debug messages"
		depends on SC_SCHED
		select KERNEL_LOG_DEBUG
		default n

	config SC_SIGNAL
		bool "user-space signal support"
		select KERNEL_SYSCALL
		select KERNEL_IPI if KERNEL_SMP
		default n
		help
			User space signaling mechanism.

	config SC_SIGNAL_DEBUG
		bool "signal debug messages"
		depends on SC_SIGNAL
		default n

	config SC_TIME
		bool "time"
		select KERNEL_SYSCALL
		select KERNEL_TIMER
		select KERNEL_SIGNAL
		default y
		help
			Timer syscalls, such as sleep and time.

	config SC_SOCKET
		bool "socket"
		select KERNEL_NET
		default n
		help
			Socket family of syscalls

	config SC_SOCKET_DEBUG
		bool "socket debug messages"
		depends on SC_SOCKET
		default n

	menu "hidden"
		visible if 0

		config KERNEL_SYSCALL
			bool "kernel syscall"

		config KERNEL_IPI
			bool "inter-processor interrupts"
	endmenu
endmenu
# }}}

#
# init binary
#
# {{{
menu "init binary settings"
	config INIT_BINARY
		hex "address of the init binary"

	choice
		prompt "init binary type"

		config INIT_BINTYPE_RAW
			bool "INIT_BINARY points to the init entry address"
			select BINLOADER_RAW

		config INIT_BINARY_ELF
			bool "INIT_BINARY points to an elf file"
			select BINLOADER_ELF
	endchoice

	config INIT_ARGS
		qstring "init argument string"
		default ""

	menu "binary loader support"
		config BINLOADER_RAW
			bool "raw binaries"

		config BINLOADER_ELF
			bool "elf binaries"
	endmenu

	menu "hidden"
		visible if 0

		config INIT_BINTYPE
			int "init binary type"
			default 0	if INIT_BINTYPE_RAW
			default 1	if INIT_BINARY_ELF
	endmenu
endmenu
# }}}

#
# scheduler
#
# {{{
menu "scheduler settigns"
	source "kernel/sched/Kconfig"
endmenu
# }}}

#
# file system
#
# {{{
menu "file system"
	source "kernel/fs/Kconfig"
endmenu
# }}}

#
# network
#
# {{{
menuconfig KERNEL_NET
	bool "networking infrastructure"
	select KERNEL_DEVFS
	select KERNEL_SIGNAL
	select SYS_RINGBUFFER

if KERNEL_NET
	source "kernel/net/Kconfig"
endif
# }}}

#
# test & debug
#
config KERNEL_TEST
	bool "execute 'kernel_test()' on boot"

config KERNEL_STAT
	bool "execute 'kernel_stat()' on boot"
	select KERNEL_LOG
# }}}
```

## kernel/fs/Kconfig
```kconfig
#
# Copyright (C) 2017 Jan Nowotsch
# Author Jan Nowotsch	<jan.nowotsch@gmail.com>
#
# Released under the terms of the GNU GPL v2.0
#



config FS_OP_TIMEOUT_US
	int "File node timeout [us]"
	default 1000000

config ROOTFS_INIT_FILE_SIZE
	int "Initial file size of rootfs files"
	default 512

config KERNEL_DEVFS
	bool "Device file system support"
```

## kernel/memory/Kconfig
```kconfig
#
# Copyright (C) 2018 Jan Nowotsch
# Author Jan Nowotsch	<jan.nowotsch@gmail.com>
#
# Released under the terms of the GNU GPL v2.0
#



config STACK_SIZE
	int "thread stack size"
	default 1024

config KMALLOC_ALIGN
	int "alignment to be used for kernel level memory allocators (has to be a power of 2)"
	default 4
```

## kernel/net/Kconfig
```kconfig
#
# Copyright (C) 2016 Jan Nowotsch
# Author Jan Nowotsch	<jan.nowotsch@gmail.com>
#
# Released under the terms of the GNU GPL v2.0
#



config NET_RXBUF_SIZE
	int "Rx buffer size"
	default 16
```

## kernel/sched/Kconfig
```kconfig
#
# Copyright (C) 2018 Jan Nowotsch
# Author Jan Nowotsch	<jan.nowotsch@gmail.com>
#
# Released under the terms of the GNU GPL v2.0
#



choice
	prompt "scheduler type"

	config SCHED_PREEMPTIVE
		bool "preemptive"
		select KTIMER

	config SCHED_COOPERATIVE
		bool "cooperative"
endchoice

config SCHED_KTIMER_MUL
	int "kernel timer scheduler multiple"
	depends on SCHED_PREEMPTIVE
	default 1

config SCHED_PRIO_DEFAULT
	int "default process priority"
	default 0
```

## lib/Kconfig
```kconfig
#
# Copyright (C) 2017 Jan Nowotsch
# Author Jan Nowotsch	<jan.nowotsch@gmail.com>
#
# Released under the terms of the GNU GPL v2.0
#



menu stdlib
	source lib/stdlib/Kconfig
endmenu

menu stdio
	source lib/stdio/Kconfig
endmenu

menuconfig LIB_GFX
	bool "graphics library"
	select FONTS

if LIB_GFX
	config GFX_INT_WIDTH
		int "integer type width"
		default 16
endif

config LIB_GETOPT
	bool "getopt library"
	default n

menu "hidden"
	visible if 0

	config LIB_MUTEX
		bool "mutex"
		select SC_SCHED		# mutex requires thread_info()
		default n
endmenu
```

## lib/stdio/Kconfig
```kconfig
#
# Copyright (C) 2018 Jan Nowotsch
# Author Jan Nowotsch	<jan.nowotsch@gmail.com>
#
# Released under the terms of the GNU GPL v2.0
#



config LIB_PRINTF
	bool "printf"
	select LIB_STREAM
	select SC_FILESYSTEM

config LIB_STREAM
	bool "[v]s*printf"
	default y

config FILE_BUF_SIZE
	int "Buffer size for FILE structures"
	depends on SC_FILESYSTEM
	default 16
```

## lib/stdlib/Kconfig
```kconfig
#
# Copyright (C) 2017 Jan Nowotsch
# Author Jan Nowotsch	<jan.nowotsch@gmail.com>
#
# Released under the terms of the GNU GPL v2.0
#



if SC_DYNMEM
	config MALLOC_MIN_SIZE
		int "minimum size to be used for malloc syscalls"
		default 128

	config MALLOC_ALIGN
		int "alignment to be used for malloc (has to be a power of 2)"
		default 4
endif # SC_DYNMEM
```

## sys/Kconfig
```kconfig
#
# Copyright (C) 2016 Jan Nowotsch
# Author Jan Nowotsch	<jan.nowotsch@gmail.com>
#
# Released under the terms of the GNU GPL v2.0
#



#
# vfprintf
#
# {{{
if KERNEL_LOG || LIB_STREAM
	config PRINTF_MINIMAL
		bool "minimalistic printf (disable long and exotic specifiers)"

	if !PRINTF_MINIMAL
		config PRINTF_LONG
			bool "enable support for printf 'l' (long) specifier"

		config PRINTF_LONGLONG
			bool "enable support for printf 'll' (long long) specifier"
			select PRINTF_LONG

		config PRINTF_INTMAX
			bool "enable support for printf 'j' (intmax_t) specifier"

		config PRINTF_SIZET
			bool "enable support for printf 'z' (size_t) specifier"

		config PRINTF_PTRDIFF
			bool "enable support for printf 't' (ptrdiff_t) specifier"

		config PRINTF_LONGDOUBLE
			bool "enable support for printf 'L' (long double) specifier"
			depends on !NOFLOAT
	endif # PRINTF_MINIMAL
endif # KERNEL_LOG || LIB_STREAM
# }}}

#
# fonts
#
# {{{
menuconfig FONTS
	bool "fonts"

if FONTS
	source "sys/fonts/Kconfig"
endif
# }}}

#
# miscellaneous
#
# {{{
config NAME_MAX
	int "maximum name length"
	default 16
	range 4 4096

menu "hidden"
	visible if 0

	config SYS_RINGBUFFER
		bool "ring buffer"
		default n

	config SYS_LINEBUFFER
		bool "line buffer"
		default n

	config SYS_PATTERN_MATCH
		bool "pattern matching api"
		default n
endmenu
# }}}
```

## sys/fonts/Kconfig
```kconfig
#
# Copyright (C) 2022 Jan Nowotsch
# Author Jan Nowotsch	<jan.nowotsch@gmail.com>
#
# Released under the terms of the GNU GPL v2.0
#



config FONT_SYSTEM_VERT
	bool "System font vertical"
```

## test/integration/Kconfig
```kconfig
#
# Copyright (C) 2020 Jan Nowotsch
# Author Jan Nowotsch	<jan.nowotsch@gmail.com>
#
# Released under the terms of the GNU GPL v2.0
#



config TEST_INT_KERNEL_IMAGE
	qstring "default kernel image"
	default "recent/kernel/kimg.elf"

config TEST_INT_APP_BINARY
	qstring "default application binary"
	default "recent/init/init.elf"

config TEST_INT_FS_EXPORT_ROOT
	qstring "directory to export the brickos file system to"
	default "recent/test/integration/brickos-fs-export"

config TEST_INT_HW_PIPE_RD
	int "host test data pipe input fileno"
	default 17

config TEST_INT_HW_PIPE_WR
	int "host test data pipe output fileno"
	default 18

config TEST_INT_USR_PIPE_RD
	int "host test control pipe input fileno"
	default 19

config TEST_INT_USR_PIPE_WR
	int "host test control pipe output fileno"
	default 20

config TEST_INT_HW_SIG
	int "host test signal for hardware operations"
	range 34 64
	default 35

config TEST_INT_USR_SIG
	int "host test signal for user operations"
	range 34 64
	default 34

config TEST_INT_CONT_SIG
	int "host test continue signal SIGCONT"
	default 18

config TEST_INT_UART_SIG
	int "host test uart signal"
	default 10
```
