/**
 * Copyright (C) 2022 Jan Nowotsch
 * Author Jan Nowotsch	<jan.nowotsch@gmail.com>
 *
 * Released under the terms of the GNU GPL v2.0
 */



#include <avr.dts>
#include <esp8266.dts>


avr_uart(
	1,		// uart name
	0xc8,	// register base (uart1)
	0x64,	// PRR0
	0x10,	// PRR0_PRUSART1
	28,		// rx interrupt (uart1)
	30,		// tx interrupt (uart1)
	2400,	// baudrate
	0,		// stop bits (1)
	0,		// parity (UART_PARITY_NONE)
	3,		// csize (UART_CS_8)

	esp8266(
		0	// esp name
	);
);
