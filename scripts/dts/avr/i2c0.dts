/**
 * Copyright (C) 2022 Jan Nowotsch
 * Author Jan Nowotsch	<jan.nowotsch@gmail.com>
 *
 * Released under the terms of the GNU GPL v2.0
 */



#include <config/config.h>
#include <avr.dts>
#include "../common/i2cdemo.dts"


#if defined(CONFIG_DRIVER_SSD1306) || defined(CONFIG_DRIVER_MCP23017) || defined(CONFIG_DRIVER_BME280)
# define I2C_INT_NUM	0
#else
# define I2C_INT_NUM	26
#endif // CONFIG_DRIVER_*


avr_i2c_bus(
	0,				// i2c name
	0xb8,			// regs
	0x64,			// PRRO
	0x80,			// PRR0_PRTWI
	100,			// clock (100kHz)
	16,				// address
	I2C_INT_NUM,	// interrupt

	i2c_demo_devices(
		0,		// i2craw name
		0,		// envsensor name
		mcp,	// mcp23017 name
		i2c		// display name
	);
);
