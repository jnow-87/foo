/**
 * Copyright (C) 2022 Jan Nowotsch
 * Author Jan Nowotsch	<jan.nowotsch@gmail.com>
 *
 * Released under the terms of the GNU GPL v2.0
 */



#include <avr.dts>
#include "../common/tty0.dts"


avr_uart(
	0,		// uart name
	0xc0,	// uart0 config register base
	0x64,	// PRR0
	0x2,	// PRR0_PRUSART0
	20,		// rx interrupt (uart0)
	22,		// tx interrupt (uart0)
	115200,	// baudrate
	0,		// stop bits (1)
	0,		// parity (UART_PARITY_NONE)
	3,		// csize (UART_CS_8)

	tty_user(
		0,	// term name
		0	// tty name
	);
);
