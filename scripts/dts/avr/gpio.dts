/**
 * Copyright (C) 2022 Jan Nowotsch
 * Author Jan Nowotsch	<jan.nowotsch@gmail.com>
 *
 * Released under the terms of the GNU GPL v2.0
 */



#include <config/config.h>
#include <avr.dts>
#include <gpio.dts>
#include "../common/heartbeat.dts"


avr_gpio(
	a,		// gpio name
	0x20,	// porta
	0x68,	// PCICR
	0x6b,	// PCMSK0
	0xf0,	// pull-up mask

	gpio(
		0,		// gpio name
		0xff,	// in mask
		0x00,	// out mask
		0xf1,	// int mask
		0xf0,	// invert mask
		4,		// interrupt (pcint0)

		gpio_port(
			0,			// gpio name
			switches,	// port name
			0xf0,		// in mask
			0x00,		// out mask
			0xf0		// int mask
		);

		gpio_port(
			0,		// gpio name
			adc,	// name
			0x0f,	// in mask
			0x00,	// out mask
			0x00	// int mask
		);

# if defined(CONFIG_DRIVER_MCP23017) && defined(CONFIG_GPIO_INTFWD)
		gpio_intfwd(
			mcp,				// pin name
			0,					// pin
			(arch.num-ints++)	// interrupt to trigger
		);
# endif // CONFIG_DRIVER_MCP23017 && CONFIG_GPIO_INTFWD
	);
);

avr_gpio(
	b,		// gpio name
	0x23,	// portb
	0x68,	// PCICR
	0x6c,	// PCMSK1
	0x01,	// pull-up mask

	gpio(
		1,		// gpio name
		0x00,	// in mask
		0x03,	// out mask
		0x00,	// int mask
		0x03,	// invert mask
		0,		// interrupt

		gpio_pin(
			1,		// gpio name
			uled,	// pin name
			0,		// pin
			0x2		// mode (out)
		);

# ifdef CONFIG_KERNEL_HEARTBEAT
		heartbeat(
			0,	// heartbeat name
			1	// pin
		);
# endif // CONFIG_KERNEL_HEARTBEAT
	);
);

avr_gpio(
	c,		// gpio name
	0x26,	// portc
	0x68,	// PCICR
	0x6d,	// PCMSK2
	0xc0,	// pull-up mask

	gpio(
		2,		// gpio name
		0xc0,	// in mask
		0xc0,	// out mask
		0xc0,	// int mask
		0xc0,	// invert mask
		6,		// interrupt (pcint2)

		gpio_port(
			2,		// gpio name
			int,	// port name
			0xc0,	// in mask
			0xc0,	// out mask
			0xc0	// int mask
		);
	);
);
