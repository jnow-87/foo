/**
 * Copyright (C) 2022 Jan Nowotsch
 * Author Jan Nowotsch	<jan.nowotsch@gmail.com>
 *
 * Released under the terms of the GNU GPL v2.0
 */



#include <avr.dts>
#include <term.dts>


avr_spi(
	0,		// spi name
	0x4c,	// spi config register base
	0x24,	// DDRB
	0x40,	// PB6 (MISO)
	0x20,	// PB5 (MOSI)
	0x80,	// PB7 (SCK)
	0x64,	// PRRO
	0x4,	// PRR0_PRSPI
	19,		// interrupt (spi)
	1,		// device mode (master)
	0,		// sample mode (CPOL = 0, CPHA = 0)
	0,		// data order (MSB first)
	1,		// prescaler (4)

	term(
		1,		// term name
		0x0,	// iflags (none)
		0x0,	// oflags (none)
		0x0,	// lflags (none)
		0,		// tabs

		tty(
			spi0	// tty name
		);
	);
);
