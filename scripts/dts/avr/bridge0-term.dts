/**
 * Copyright (C) 2022 Jan Nowotsch
 * Author Jan Nowotsch	<jan.nowotsch@gmail.com>
 *
 * Released under the terms of the GNU GPL v2.0
 */



#include <bridge.dts>
#include <term.dts>


bridge(
	0uart,				// bridge name
	0,					// id
	2,					// chunksize
	(arch.num-ints++),	// rx interrupt
	(arch.num-ints++),	// tx interrupt

	bridge_uart_dev(
		3,	// uart name

		term(
			brdg0,	// term name
			0x0,	// iflags (none)
			0x0,	// oflags (none)
			0x0,	// lflags (none)
			0,		// tabs

			tty(
				brdg0	// tty name
			);
		);
	);
);
