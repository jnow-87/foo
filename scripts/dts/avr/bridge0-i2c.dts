/**
 * Copyright (C) 2022 Jan Nowotsch
 * Author Jan Nowotsch	<jan.nowotsch@gmail.com>
 *
 * Released under the terms of the GNU GPL v2.0
 */



#include <avr.dts>
#include <bridge.dts>


avr_i2c_bus(
	1,		// i2c name
	0xb8,	// register base
	0x64,	// PRRO
	0x80,	// PRR0_PRTWI
	100,	// clock (100kHz)
	16,		// address
	0,		// interrupt

	bridge_i2c_itf(
		0i2ci,				// bridge name
		0,					// id
		2,					// chunksize
		(arch.num-ints++),	// rx interrupt
		(arch.num-ints++)	// tx interrupt
	);
);
