/**
 * Copyright (C) 2022 Jan Nowotsch
 * Author Jan Nowotsch	<jan.nowotsch@gmail.com>
 *
 * Released under the terms of the GNU GPL v2.0
 */



#include <avr.dts>


avr_eeprom(
	0,		// eeprom name
	0x3f,	// register base
	0x0,	// base address
	4096,	// size
	25		// interrupt (eeprom)
);
