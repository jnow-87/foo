/**
 * Copyright (C) 2022 Jan Nowotsch
 * Author Jan Nowotsch	<jan.nowotsch@gmail.com>
 *
 * Released under the terms of the GNU GPL v2.0
 */



#include <avr.dts>


avr_pwm16(
	1,		// pwm name
	0x80,	// tcc1 config register base
	0x36,	// TIFR1
	0x6f,	// TIMSK1
	0x64,	// PRR0
	0x08,	// PRR0_PRTIM1
	0x2a,	// DDRD
	0x30	// DDRD bits 4..5
);
