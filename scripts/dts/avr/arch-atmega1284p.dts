/**
 * Copyright (C) 2022 Jan Nowotsch
 * Author Jan Nowotsch	<jan.nowotsch@gmail.com>
 *
 * Released under the terms of the GNU GPL v2.0
 */



#include <config/config.h>


addr-width = 16;
reg-width = 8;

ncores = 1;

// interrupts
//  35 hardwares
//   1 syscall
//   1 instruction overflow
num-ints = 37;
num-vints = 0
#ifdef CONFIG_BRIDGE_I2C_ITF
	+ 2
#endif // CONFIG_BRIDGE_I2C_ITF

#ifdef CONFIG_BRIDGE_UART_DEV
	+ 2
#endif // CONFIG_BRIDGE_UART_DEV

#if defined(CONFIG_DRIVER_MCP23017) && defined(CONFIG_GPIO_INTFWD)
	+ 3
#endif // CONFIG_DRIVER_MCP23017 && CONFIG_GPIO_INTFWD

#ifdef CONFIG_DRIVER_GPIO
	+ 2
#endif // CONFIG_DRIVER_GPIO
;

timer-int = 8;
syscall-int = 35;

timer-cycle-time-us = 31250; 

plt = {
	compatible = "avr,platform";

	// config (avr_platform_cfg_t)
	int<32> = [ 20000000 ];	// system clock [Hz]
	int<8> = [ 0 ];			// system clock prescale (1)
	int<8> = [ 0x1 ];		// watchdog prescaler (4096 -> 31.250ms)
};
