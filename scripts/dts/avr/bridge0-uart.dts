/**
 * Copyright (C) 2022 Jan Nowotsch
 * Author Jan Nowotsch	<jan.nowotsch@gmail.com>
 *
 * Released under the terms of the GNU GPL v2.0
 */



#include <avr.dts>
#include <bridge.dts>
#include <uart.dts>


avr_uart(
	2,		// uart name
	0xc8,	// register base (uart1)
	0x64,	// PRR0
	0x10,	// PRR0_PRUSART1
	28,		// rx interrupt (uart1)
	30,		// tx interrupt (uart1)
	115200,	// baudrate
	0,		// stop bits (1)
	0,		// parity (UART_PARITY_NONE)
	3,		// csize (UART_CS_8)

	bridge_uart_itf(
		0uarti,	// bridge name
		0,		// id
		2,		// chunksize
		0,		// rx interrupt
		0		// tx interrupt
	);
);
