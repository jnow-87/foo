/**
 * Copyright (C) 2024 Jan Nowotsch
 * Author Jan Nowotsch	<jan.nowotsch@gmail.com>
 *
 * Released under the terms of the GNU GPL v2.0
 */



#ifndef AVR_DTS
#define AVR_DTS


#include <uart.dts>
#include <spi.dts>


/* macros */
// avr platform
#define avr_platform(sys_clk_hz, sys_clk_prescale, wdt_prescale) \
	plt = { \
		compatible = "avr,platform"; \
		\
		/* avr platform config (avr_platform_cfg_t) */ \
		int<32> = [ sys_clk_hz ]; \
		int<8> = [ sys_clk_prescale ]; \
		int<8> = [ wdt_prescale ]; \
	}

// avr uart
#define avr_uart(name, regs, prr, prr_mask, rx_int, tx_int, baudrate, nstop, parity, csize, ...) \
	uart ##name = { \
		compatible = "avr,uart"; \
		\
		/* avr uart driver config (dt_data_t) */ \
		addr = regs; \
		addr = prr; \
		int<8> = [ prr_mask ]; \
		\
		int<8> = [ \
			rx_int, \
			tx_int, \
		]; \
		\
		uart_cfg_t(baudrate, nstop, parity, csize); \
		\
		/* childs */ \
		__VA_ARGS__ \
	}

// avr gpio
#define avr_gpio(name, regs, pcicr, pc_mask, pullup_mask, ...) \
	port ##name = { \
		compatible = "avr,gpio"; \
		\
		/* avr gpio config (dt_data_t) */ \
		addr = regs; \
		addr = pcicr; \
		addr = pc_mask; \
		\
		int<8> = [ \
			pullup_mask, \
		]; \
		\
		/* childs */ \
		__VA_ARGS__ \
	}

// avr spi
#define avr_spi(name, regs, ddr, miso, mosi, sck, prr, prr_mask, int_num, dev_mode, sample_mode, data_order, prescaler, ...) \
	spi ##name = { \
		compatible = "avr,spi"; \
		\
		/* avr spi driver config (dt_data_t) */ \
		addr = regs; \
		addr = ddr; \
		int<8> = [ \
			miso, \
			mosi, \
			sck, \
		]; \
		\
		addr = prr; \
		int<8> = [ prr_mask ]; \
		\
		int<8> = [ int_num ]; \
		\
		spi_cfg_t(dev_mode, sample_mode, data_order, prescaler); \
		\
		/* childs */ \
		__VA_ARGS__ \
	}

// avr pwm
#define avr_pwm8(name, regs, tifr, tifr_mask, prr, prr_mask, ddr, ddr_mask) \
	pwm ##name = { \
		compatible = "avr,pwm8"; \
		\
		/* avr pwm config (dt_data_t) */ \
		addr = regs; \
		addr = tifr; \
		addr = tifr_mask; \
		addr = prr; \
		int<8> = [ prr_mask ]; \
		\
		addr = ddr; \
		int<8> = [ ddr_mask ]; \
	}

#define avr_pwm16(name, regs, tifr, tifr_mask, prr, prr_mask, ddr, ddr_mask) \
	pwm ##name = { \
		compatible = "avr,pwm16"; \
		\
		/* avr pwm config (dt_data_t) */ \
		addr = regs; \
		addr = tifr; \
		addr = tifr_mask; \
		addr = prr; \
		int<8> = [ prr_mask ]; \
		\
		addr = ddr; \
		int<8> = [ ddr_mask ]; \
	}

// avr i2c bus
#define avr_i2c_bus(name, regs, prr, prr_mask, clock_khz, slave, int_num, ...) \
	i2c ##name = { \
		compatible = "avr,i2c"; \
		\
		/* avr i2c driver config (dt_data_t) */ \
		addr = regs; \
		addr = prr; \
		int<8> = [ prr_mask ]; \
		\
		i2c_bus(name, clock_khz, slave, int_num, __VA_ARGS__); \
	}

// avr eeprom
#define avr_eeprom(name, regs, mem_base, mem_size, int_num) \
	eeprom ##name = { \
		compatible = "avr,eeprom"; \
		\
		/* avr eeprom driver config (dt_data_t) */ \
		addr = regs; \
		\
		int<16> = [ \
			mem_base, \
			mem_size, \
		]; \
		\
		int<8> = [ int_num ]; \
	}


#endif // AVR_DTS
