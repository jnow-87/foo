/**
 * Copyright (C) 2024 Jan Nowotsch
 * Author Jan Nowotsch	<jan.nowotsch@gmail.com>
 *
 * Released under the terms of the GNU GPL v2.0
 */



#ifndef ESP8266_DTS
#define ESP8266_DTS


#include <names.dts>


/* macros */
// esp8266 device
#define esp8266(name) \
	netdev_name(name) = { \
		compatible = "esp8266"; \
	}


#endif // ESP8266_DTS
