/**
 * Copyright (C) 2024 Jan Nowotsch
 * Author Jan Nowotsch	<jan.nowotsch@gmail.com>
 *
 * Released under the terms of the GNU GPL v2.0
 */



#ifndef RP2040_DTS
#define RP2040_DTS


#include <i2c.dts>
#include <uart.dts>


/* macros */
// rp2040 pll config (rp2040_pll_cfg_t)
#define rp2040_pll_cfg_t(ref_div, post_div1, post_div2 , feedback_div) \
	int<8> = [ \
		ref_div, \
		post_div1, \
		post_div2, \
	]; \
	int<16> = [ feedback_div ];

// rp2040 gpio function selection (array wrapper)
#define rp2040_gpio_funcsel(...)  \
	int<8> = [ __VA_ARGS__ ];

// rp2040 platform
#define rp2040_platform(crystal_clk_khz, pll_sys, pll_usb, gpio_funcsel, gpio_v33) \
	plt = { \
		compatible = "rp2040,platform"; \
		\
		int<32> = [ \
			crystal_clk_khz, \
			0, /* system clock [kHz] (set by the platform) */ \
			0, /* peripheral clock [kHz] (set by the platform) */ \
		]; \
		\
		pll_sys \
		pll_usb \
		\
		gpio_funcsel \
		int<8> = [gpio_v33 ]; \
	}

// rp2040 uart
#define rp2040_uart(name, regs, reset_id, int_num, baudrate, nstop, parity, csize, ...) \
	uart ##name = { \
		compatible = "rp2040,uart"; \
		\
		/* rp2040 uart config (dt_data_t) */ \
		baseaddr = regs; \
		\
		int<8> = [ \
			reset_id, \
			int_num, \
			(arch.num-ints++),	/* rx interrupt */ \
			(arch.num-ints++)	/* tx interrupt */ \
		]; \
		\
		uart_cfg_t(baudrate, nstop, parity, csize); \
		\
		/* childs */ \
		__VA_ARGS__ \
	}

// rp2040 gpio
#define rp2040_gpio(name, pu_mask, pd_mask, schmitt_en, slewfast, drv_2ma, drv_4ma, drv_8ma, drv_12ma, ...) \
	port ##name = { \
		compatible = "rp2040,gpio"; \
		\
		/* rp2040 gpio config (dt_data_t) */ \
		int<32> = [ \
			pu_mask, \
			pd_mask, \
			schmitt_en, \
			slewfast, \
			drv_2ma, \
			drv_4ma, \
			drv_8ma, \
			drv_12ma, \
		];\
		\
		/* childs */ \
		__VA_ARGS__ \
	}

// rp2040 i2c bus
#define rp2040_i2c_bus(name, regs, reset_id, clock_khz, addr, int_num, ...) \
	i2c ##name = { \
		compatible = "rp2040,i2c"; \
		\
		/* rp2040 i2c config (dt_data_t) */ \
		baseaddr = regs; \
		int<8> = [ reset_id ]; \
		\
		i2c_bus(name, clock_khz, addr, int_num, __VA_ARGS__); \
	}


#endif // RP2040_DTS
