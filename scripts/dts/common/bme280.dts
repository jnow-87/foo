/**
 * Copyright (C) 2023 Jan Nowotsch
 * Author Jan Nowotsch	<jan.nowotsch@gmail.com>
 *
 * Released under the terms of the GNU GPL v2.0
 */



#include <bme280.dts>


bme280 = {
	compatible = "bme280";

	bme280_dtd(
		118,	// slave address
		1,		// mode (forced)
		0x7,	// features (all)
		0,		// standby time (500)
		0,		// filter (off)
		1,		// temperature oversampling (1)
		1,		// pressure oversampling (1)
		1		// humidity oversampling (1)
	)
};
