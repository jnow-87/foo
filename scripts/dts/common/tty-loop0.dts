/**
 * Copyright (C) 2022 Jan Nowotsch
 * Author Jan Nowotsch	<jan.nowotsch@gmail.com>
 *
 * Released under the terms of the GNU GPL v2.0
 */



#include <loop.dts>
#include <term.dts>


loop1 = {
	compatible = "loop,term";

	loop_cfg_t(
		32	// buffer size
	)

	loop1-term = {
		compatible = "terminal";

		term_cfg_t(
			0x0,		// iflags (none)
			0x0,		// oflags (none)
			0x0,		// lflags (none)
			0			// tabs
		)

		tty-loop0 = {
			compatible = "terminal,raw";
		};
	};
};
