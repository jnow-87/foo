/**
 * Copyright (C) 2024 Jan Nowotsch
 * Author Jan Nowotsch	<jan.nowotsch@gmail.com>
 *
 * Released under the terms of the GNU GPL v2.0
 */



#ifndef COMMON_HEARTBEAT_DTS
#define COMMON_HEARTBEAT_DTS


#include <kheartbeat.dts>


/* macros */
// heartbeat device
#define heartbeat(name, pin) \
	kernel_heartbeat( \
		name, \
		pin, \
		0x0505,	/* wave */ \
		200		/* period [ms] */ \
	)


#endif // COMMON_HEARTBEAT_DTS
