/**
 * Copyright (C) 2022 Jan Nowotsch
 * Author Jan Nowotsch	<jan.nowotsch@gmail.com>
 *
 * Released under the terms of the GNU GPL v2.0
 */



#include <loop.dts>


loop0 = {
	compatible = "loop,block";

	loop_cfg_t(
		32	// buffer size
	)
};
