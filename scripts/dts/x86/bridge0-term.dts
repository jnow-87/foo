/**
 * Copyright (C) 2022 Jan Nowotsch
 * Author Jan Nowotsch	<jan.nowotsch@gmail.com>
 *
 * Released under the terms of the GNU GPL v2.0
 */



#include <bridge.dts>


brdg0-right-uart = {
	compatible = "bridge,itf";

	bridge_cfg_t(
		0,					// id
		2,					// chunksize
		(arch.num-ints++),	// rx interrupt
		(arch.num-ints++)	// tx interrupt
	)

	brdg0-itf-uart = {
		compatible = "bridge,uart-dev";

		brdg0-term = {
			compatible = "terminal";

			term_cfg_t(
				0x0,		// iflags (none)
				0x0,		// oflags (none)
				0x0,		// lflags (none)
				0			// tabs
			)

			tty-bridge0 = {
				compatible = "terminal,raw";
			};
		};
	};
};
