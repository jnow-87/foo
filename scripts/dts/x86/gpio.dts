/**
 * Copyright (C) 2022 Jan Nowotsch
 * Author Jan Nowotsch	<jan.nowotsch@gmail.com>
 *
 * Released under the terms of the GNU GPL v2.0
 */



#include <gpio.dts>
#include <x86.dts>


x86_gpio(
	0,	// gpio name
	0,	// interrupt timer period [ms]

	gpio(
		0,		// gpio name
		0xff,	// in mask
		0xff,	// out mask
		0x00,	// int mask
		0x00,	// invert mask
		0,		// interrupt

		gpio_port(
			0,		// gpio name
			0, 		// port name
			0xff,	// in mask
			0xff,	// out mask
			0x00	// int mask
		);
	);
);
