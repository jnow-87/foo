/**
 * Copyright (C) 2022 Jan Nowotsch
 * Author Jan Nowotsch	<jan.nowotsch@gmail.com>
 *
 * Released under the terms of the GNU GPL v2.0
 */



#include <bridge.dts>
#include "../common/i2cdemo.dts"


bridge(
	0i2c,	// bridge name
	0,		// id
	2,		// chunksize
	0,		// rx interrupt
	0,		// tx interrupt

	bridge_i2c_dev(
		0,	// bridge name
		0,	// clk_khz
		17,	// addr

		i2c_demo_devices(
			0,		// i2craw name
			0,		// envsensor name
			mcp,	// mcp23017 name
			i2c		// display name
		);
	);
);
