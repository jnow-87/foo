/**
 * Copyright (C) 2022 Jan Nowotsch
 * Author Jan Nowotsch	<jan.nowotsch@gmail.com>
 *
 * Released under the terms of the GNU GPL v2.0
 */



#include <x11.dts>
#include "../common/vramdemo.dts"


x11_dsp(
	x11,	// display name
	3,		// scale

	vram_demo(
		x11,	// vram name
		3,		// term name
		x11,	// tty name
		128,	// width
		64		// height
	);
);
