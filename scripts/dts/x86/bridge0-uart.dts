/**
 * Copyright (C) 2022 Jan Nowotsch
 * Author Jan Nowotsch	<jan.nowotsch@gmail.com>
 *
 * Released under the terms of the GNU GPL v2.0
 */




#include <bridge.dts>
#include <x86.dts>


x86_uart(
	1,				// uart name
	"/dev/ttyUSB1",	// path
	0,				// rx interrupt
	0,				// tx interrupt
	115200,			// baudrate
	0,				// stop bits (1)
	0,				// parity (UART_PARITY_NONE)
	3,				// csize (UART_CS_8)

	bridge_uart_itf(
		0uarti,		// bridge name
		0,			// id
		2,			// chunksize
		0,			// rx interrupt
		0			// tx interrupt
	);
);
