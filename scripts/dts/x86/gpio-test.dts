/**
 * Copyright (C) 2022 Jan Nowotsch
 * Author Jan Nowotsch	<jan.nowotsch@gmail.com>
 *
 * Released under the terms of the GNU GPL v2.0
 */



#include <gpio.dts>
#include <x86.dts>


x86_gpio(
	1,	// gpio name
	10,	// interrupt timer period [ms]

	gpio(
		1,					// gpio name
		0xffffffff,			// in mask
		0xffffffff,			// out mask
		0xffffffff,			// int mask
		0x000005f5,			// invert mask
		(arch.num-ints++),	// interrupt

		gpio_port(
			1,		// gpio name
			0,		// port name
			0xff0f,	// in mask
			0xff00,	// out mask
			0x000f	// int mask
		);

		gpio_pin(
			1,		// gpio name
			0,		// pin name
			4,		// pin
			0x3		// mode (i/o)
		);

		gpio_port(
			1,				// gpio name
			int0,			// port name
			0xffffffff,		// in mask
			0xffffffff,		// out mask
			0xffffffff		// int mask
		);
	);
);
