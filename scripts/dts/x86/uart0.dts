/**
 * Copyright (C) 2022 Jan Nowotsch
 * Author Jan Nowotsch	<jan.nowotsch@gmail.com>
 *
 * Released under the terms of the GNU GPL v2.0
 */




#include <x86.dts>
#include "../common/tty0.dts"


x86_uart(
	0,				// uart name
	"/dev/stdin",	// path
	3,				// rx interrupt
	0,				// tx interrupt
	115200,			// baudrate
	0,				// stop bits (1)
	0,				// parity (UART_PARITY_NONE)
	3,				// csize (UART_CS_8)

	tty_user(
		0,	// term name
		0	// tty name
	);
);
