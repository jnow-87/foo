/**
 * Copyright (C) 2024 Jan Nowotsch
 * Author Jan Nowotsch	<jan.nowotsch@gmail.com>
 *
 * Released under the terms of the GNU GPL v2.0
 */



#include <rp2040.dts>
#include "../common/tty0.dts"


rp2040_uart(
	0,			// uart name
	0x40034000,	// uart0 register base
	22,			// reset id
	36,			// interrupt
	115200,		// baudrate
	0,			// stop bits (1)
	0,			// parity (UART_PARITY_NONE)
	3,			// csize (UART_CS_8)

	tty_user(
		0,	// term name
		0	// tty name
	);
);
