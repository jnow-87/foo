/**
 * Copyright (C) 2024 Jan Nowotsch
 * Author Jan Nowotsch	<jan.nowotsch@gmail.com>
 *
 * Released under the terms of the GNU GPL v2.0
 */



#include <config/config.h>
#include <rp2040.dts>
#include "../common/i2cdemo.dts"


#if defined(CONFIG_DRIVER_SSD1306) || defined(CONFIG_DRIVER_MCP23017) || defined(CONFIG_DRIVER_BME280)
# define I2C_INT_NUM	0
#else
# define I2C_INT_NUM	39
#endif // CONFIG_DRIVER_*


rp2040_i2c_bus(
	0,				// i2c name
	0x40044000,		// regs (i2c0)
	3,				// reset id (i2c0)
	100,			// clock [kHz]
	18,				// address
	I2C_INT_NUM,	// interrupt

	i2c_demo_devices(
		0,		// i2craw name
		0,		// envsensor name
		mcp,	// mcp23017 name
		i2c		// display name
	);
);
