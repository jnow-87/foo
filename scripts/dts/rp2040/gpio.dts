/**
 * Copyright (C) 2024 Jan Nowotsch
 * Author Jan Nowotsch	<jan.nowotsch@gmail.com>
 *
 * Released under the terms of the GNU GPL v2.0
 */



#include <config/config.h>
#include <gpio.dts>
#include <rp2040.dts>
#include "../common/heartbeat.dts"


rp2040_gpio(
	0,			// gpio name
	0x00000000,	// pullup_mask,
	0x00000030,	// pulldown_mask,
	0x00000030,	// schmitt_en,
	0x00000000,	// slewfast,
	0x00000030,	// drive_2ma,
	0x00000000,	// drive_4ma,
	0x00000000,	// drive_8ma,
	0x02008000,	// drive_12ma,

	gpio(
		0,			// gpio name
		0x00000030,	// in mask
		0x020080c0,	// out mask
		0x00000030,	// int mask
		0x000000c0,	// invert mask
		29,			// interrupt (io_irq_bank0)

		gpio_port(
			0,			// gpio name
			0,			// port name
			0x00000030,	// in mask
			0x000000c0,	// out mask
			0x00000030	// int mask
		);

		gpio_pin(
			0,		// gpio name
			uled,	// pin name
			15,		// pin
			0x2		// mode (out)
		);

# ifdef CONFIG_KERNEL_HEARTBEAT
		heartbeat(
			0,	// heartbeat name
			25	// pin
		);
# endif // CONFIG_KERNEL_HEARTBEAT
	);
);
