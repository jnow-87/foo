/**
 * Copyright (C) 2024 Jan Nowotsch
 * Author Jan Nowotsch	<jan.nowotsch@gmail.com>
 *
 * Released under the terms of the GNU GPL v2.0
 */



#include <config/config.h>


addr-width = 32;
reg-width = 32;

ncores = 2;

// interrupts
num-ints = 42;
num-vints = 0
#ifdef CONFIG_RP2040_UART
	+ 2
#endif // CONFIG_RP2040_UART
;

timer-int = 15;
syscall-int = 11;
ipi-int = 31;

timer-cycle-time-us = 125000;

plt = {
	compatible = "rp2040,platform";

	// config (rp2040_platform_cfg_t)
	int<32> = [
		12000,		// crystal clock [kHz]
		0,			// system clock [kHz] (set by the platform)
		0,			// peripheral clock [kHz] (set by the platform)
	];

	// system pll (133 MHz)
	int<8> = [
		1,			// reference clock divider
		6,			// post divider 1
		2,			// post divider 2
	];
	int<16> = [
		133,		// feedback divider
	];

	// usb pll (48 MHz)
	int<8> = [
		1,			// reference clock divider
		6,			// post divider 1
		4,			// post divider 2
	];
	int<16> = [
		96,			// feedback divider
	];

	// gpio function selection
	int<8> = [
		2,		// gpio0 (uart0 tx)
		2,		// gpio1 (uart0 rx)
		31,		// gpio2 (reset)
		31,		// gpio3 (reset)
		31,		// gpio4 (reset)
		31,		// gpio5 (reset)
		31,		// gpio6 (reset)
		31,		// gpio7 (reset)
		31,		// gpio8 (reset)
		31,		// gpio9 (reset)
		31,		// gpio10 (reset)
		31,		// gpio11 (reset)
		31,		// gpio12 (reset)
		31,		// gpio13 (reset)
		31,		// gpio14 (reset)
		5,		// gpio15 (sio)
		31,		// gpio16 (reset)
		31,		// gpio17 (reset)
		31,		// gpio18 (reset)
		31,		// gpio19 (reset)
		31,		// gpio20 (reset)
		31,		// gpio21 (reset)
		31,		// gpio22 (reset)
		31,		// gpio23 (reset)
		31,		// gpio24 (reset)
		5,		// gpio25 (sio)
		31,		// gpio26 (reset)
		31,		// gpio27 (reset)
		31,		// gpio28 (reset)
		31,		// gpio29 (reset)
	];

	int<8> = [ 1 ];		// gpio voltage select (3.3v)
};
