## Kconfig
```kconfig
#
# Copyright (C) 2016 Jan Nowotsch
# Author Jan Nowotsch	<jan.nowotsch@gmail.com>
#
# Released under the terms of the GNU GPL v2.0
#



mainmenu "brickos configuration"

#
# processor type
#
# {{{
menu "processor"
	source "arch/Kconfig"
endmenu
# }}}

#
# kernel
#
# {{{
menu "kernel"
	source kernel/Kconfig
endmenu
# }}}

#
# device driver
#
# {{{
menu "device driver"
	source "driver/Kconfig"
endmenu
# }}}

#
# sys
#
# {{{
menu "sys"
	source "sys/Kconfig"
endmenu
# }}}

#
# libbrick
#
# {{{
menu "libbrick"
	source lib/Kconfig
endmenu
# }}}

#
# init
#
# {{{
menu "init"
	source init/Kconfig
endmenu
# }}}

#
# test
#
# {{{
menu "test"
	source test/integration/Kconfig
endmenu
# }}}

#
# build system
#
# {{{
menu "build system"
	# build type
	choice
		prompt "build type"

		config BUILD_DEBUG
			bool "debug"

		config BUILD_RELEASE
			bool "release"
	endchoice

	menu "hidden"
		visible if 0

		config BUILD_TYPE
			string "build type"
			default "debug" if BUILD_DEBUG
			default "release" if BUILD_RELEASE
	endmenu

	# AVR programmer
	menu "aVR programmer"
		depends on AVR

		config AVR_FUSER
			string "fuser"
			default "avrfuser"

		config AVR_PROG
			string "programmer"
			default "avrdude"

		config AVR_DEBUGGER
			string "debugger"
			default "avarice"

		choice
			prompt "programmer type"

			config AVR_DRAGON_JTAG
				bool "aVR Dragon JTAG"
				depends on ATMEGA1284P

			config AVR_DRAGON_ISP
				bool "aVR Dragon ISP"

			config AVR_STK500V2
				bool "sTK500v2"
		endchoice

		choice
			prompt "programmer port"

			config AVR_PROG_PORT_USB
				bool "usb"

			config AVR_PROG_PORT_UART
				bool "uart"
		endchoice

		config AVR_PROG_UART_DEV
			string "uart device"
			default "/dev/ttyUSB0"
			depends on AVR_PROG_PORT_UART

		config AVR_JTAG_BASE_CLOCK_HZ
			int "avr jtag clock [Hz]"
			default 1000000
			depends on AVR_DRAGON_JTAG

		menu "hidden"
			visible if 0

			config AVR_PROG_PORT
				string "programmer port"
				default "usb" if AVR_PROG_PORT_USB
				default AVR_PROG_UART_DEV if AVR_PROG_PORT_UART
				default "unknown programmer port"

			config AVR_PROG_DEBUG_ARGS
				string "programmer debug arguments"
				default "--debugwire" if AVR_DRAGON_ISP || AVR_STK500V2
				default "--dragon --jtag $(CONFIG_AVR_PROG_PORT) --jtag-bitrate $(shell echo '$(CONFIG_AVR_JTAG_BASE_CLOCK_HZ) / (4 * 1000)' | bc -q)kHz" if AVR_DRAGON_JTAG
				default ""

			config AVR_PROG_TYPE
				string "programmer"
				default "dragon_jtag" if AVR_DRAGON_JTAG
				default "dragon_isp" if AVR_DRAGON_ISP
				default "stk500v2" if AVR_STK500V2
				default "unkown programmer"
		endmenu
	endmenu

	# build tree
	config BUILD_TREE
		string "build tree"
		default "build/$(CONFIG_PROCESSOR)/$(CONFIG_BUILD_TYPE)"

	config CODE_COVERAGE
		bool "code coverage support"
		default n

	# toolchain prefixes
	config TOOLCHAIN_PREFIX
		string "target toolchain prefix"
		default "avr-" if AVR
		default ""

	menu "hidden"
		visible if 0

		config CC
			string CC
			default "$(CONFIG_TOOLCHAIN_PREFIX)gcc"

		config CXX
			string CXX
			default "$(CONFIG_TOOLCHAIN_PREFIX)g++"

		config AS
			string AS
			default "$(CONFIG_TOOLCHAIN_PREFIX)as"

		config AR
			string AR
			default "$(CONFIG_TOOLCHAIN_PREFIX)ar"

		config LD
			string LD
			default "$(CONFIG_TOOLCHAIN_PREFIX)ld"
	endmenu

	config HOSTTOOLCHAIN_PREFIX
		string "host toolchain prefix"
		default ""

	menu "hidden"
		visible if 0

		config HOSTCC
			string HOSTCC
			default "$(HOSTCONFIG_TOOLCHAIN_PREFIX)gcc"

		config HOSTCXX
			string HOSTCXX
			default "$(HOSTCONFIG_TOOLCHAIN_PREFIX)g++"

		config HOSTAS
			string HOSTAS
			default "$(HOSTCONFIG_TOOLCHAIN_PREFIX)as"

		config HOSTAR
			string HOSTAR
			default "$(HOSTCONFIG_TOOLCHAIN_PREFIX)ar"

		config HOSTLD
			string HOSTLD
			default "$(HOSTCONFIG_TOOLCHAIN_PREFIX)ld"
	endmenu

	# toolchain flags
	menu "target flags"
		config CFLAGS
			string CFLAGS

		config CXXFLAGS
			string CXXFLAGS

		config CPPFLAGS
			string CPPFLAGS

		config ASFLAGS
			string ASFLAGS

		config LDFLAGS
			string LDFLAGS

		config LDLIBS
			string LDLIBS

		config ARCHFLAGS
			string ARCHFLAGS
	endmenu

	menu "host flags"
		config HOSTCFLAGS
			string HOSTCFLAGS

		config HOSTCXXFLAGS
			string HOSTCXXFLAGS

		config HOSTCPPFLAGS
			string HOSTCPPFLAGS

		config HOSTASFLAGS
			string HOSTASFLAGS

		config HOSTLDFLAGS
			string HOSTLDFLAGS

		config HOSTLDLIBS
			string HOSTLDLIBS

		config HOSTARCHFLAGS
			string HOSTARCHFLAGS
	endmenu
endmenu
# }}}
```

## arch/Kconfig
```kconfig
#
# Copyright (C) 2016 Jan Nowotsch
# Author Jan Nowotsch	<jan.nowotsch@gmail.com>
#
# Released under the terms of the GNU GPL v2.0
#



#
# processor type and features menus
#
# {{{
choice
	prompt "processor type"

	config ARM
		bool "arm"
		select NOFLOAT
		select KERNEL_NO_VIRT_MEM

	config AVR
		bool "avr"
		select NOFLOAT
		select KERNEL_NO_VIRT_MEM

	config X86
		bool "x86 (host test)"
		select NOFLOAT
		select KERNEL_NO_VIRT_MEM
endchoice

menu "processor features"
	if ARM
		source "arch/arm/Kconfig"
	endif

	if AVR
		source "arch/avr/Kconfig"
	endif

	if X86
		source "arch/x86/Kconfig"
	endif
endmenu

# }}}

#
# common settings
#
# {{{
config DEVICE_TREE
	string "device tree script"
	default "scripts/dts/$(CONFIG_PROCESSOR).dts"

menu "hidden"
	visible if 0

	config ARCH
		string "architecture"
		default "arm"	if ARM
		default "avr"	if AVR
		default "x86"	if X86
	
	config PROCESSOR
		string "processor"
		default ARM_CHIP	if ARM
		default AVR_MCU		if AVR
		default "x86"		if X86

	config ARCH_HEADER
		string "arch header"
		default "<arch/$(CONFIG_ARCH)/$(CONFIG_ARM_CHIP).h>"	if ARM
		default "<arch/$(CONFIG_ARCH)/atmega.h>"				if AVR
		default "<arch/$(CONFIG_ARCH)/x86.h>"					if X86

	config NOFLOAT
		bool "enable floating point support"
		default n
endmenu
# }}}
```

## arch/arm/Kconfig
```kconfig
#
# Copyright (C) 2023 Jan Nowotsch
# Author Jan Nowotsch	<jan.nowotsch@gmail.com>
#
# Released under the terms of the GNU GPL v2.0
#



#
# chip
#
# {{{
choice
	prompt "chip"
		
	config ARM_CHIP_RP2040
		bool "rp2040"
		select ARM_FAMILY_V6M
		select ARM_CORE_CORTEXM0PLUS
endchoice

menu "hidden"
	visible if 0

	config ARM_CHIP
		string "chip"
		default "rp2040"	if ARM_CHIP_RP2040
endmenu
# }}}

#
# family, core, isa
#
# {{{
menu "hidden"
	visible if 0

	config ARM_FAMILY_V6M
		bool "arm v6-m"

	config ARM_FAMILY
		string "family"
		default "v6m"	if ARM_FAMILY_V6M
		default "unknown family"

	config ARM_CORE_CORTEXM0PLUS
		bool "arm cortex m0+"
		select ARM_ISA_THUMB

	config ARM_CORE
		string "core"
		default "cortex-m0plus"	if ARM_CORE_CORTEXM0PLUS
		default "unknown core"

	config ARM_ISA_THUMB
		bool "thumb"

	config ARM_ISA_ARM
		string "arm"

	config ARM_ISA
		string "isa"
		default "thumb"	if ARM_ISA_THUMB
		default "arm"	if ARM_ISA_ARM
		default "unknown isa"
endmenu
# }}}
```

## arch/arm/atmel/Kconfig
```kconfig
#
# Copyright (C) 2019 Jan Nowotsch
# Author Jan Nowotsch	<jan.nowotsch@gmail.com>
#
# Released under the terms of the GNU GPL v2.0
#



#
# clock configuration
#
menu "Clock configuration"
	if ATMEL_PMC
		source arch/arm/atmel/Kconfig.pmc
	endif
endmenu

#
# flash configuration
#
menu "Flash configuration"
	if ATMEL_EEFC
		source arch/arm/atmel/Kconfig.eefc
	endif
endmenu

#
# options to be selected by specific boards
#
menu "Hidden"
	visible if 0

	config ATMEL_PMC
		bool "Atmel power management controller"
		default 0

	config ATMEL_EEFC
		bool "Atmel enhanced embedded flash controller"
		default 0

	config ATMEL_PIO
		bool "Atmel peripheral parallel I/O controller"
		default 0
endmenu
```

## arch/arm/board/atmel/Kconfig
```kconfig
#
# Copyright (C) 2019 Jan Nowotsch
# Author Jan Nowotsch	<jan.nowotsch@gmail.com>
#
# Released under the terms of the GNU GPL v2.0
#



#
# clock configuration
#
menu "Clock configuration"
	if ATMEL_PMC
		source arch/arm/board/atmel/Kconfig.pmc
	endif
endmenu

#
# options to be selected by specific boards
#
menu "Hidden"
	visible if 0

	config ATMEL_PMC
		bool "Atmel power management controller"
		default 0
endmenu
```

## arch/arm/board/atmel/Kconfig.eefc
```kconfig
#
# Copyright (C) 2019 Jan Nowotsch
# Author Jan Nowotsch	<jan.nowotsch@gmail.com>
#
# Released under the terms of the GNU GPL v2.0
#



config EEFC_WAITSTATE
	int "Number of read/write wait states"
	range 1 16
	default 1
```

## arch/arm/board/atmel/Kconfig.pmc
```kconfig
#
# Copyright (C) 2019 Jan Nowotsch
# Author Jan Nowotsch	<jan.nowotsch@gmail.com>
#
# Released under the terms of the GNU GPL v2.0
#



#
# main clock (MAINCK)
#
# {{{
menu "Main clock (MAINCK)"
	choice
		prompt "Main clock source"
		
		config PMC_MAINCK_SRC_RC
			bool "RC oscillator"

		config PMC_MAINCK_SRC_CRYSTAL
			bool "Crystal oscillator"
	endchoice

	# RC oscillator
	if PMC_MAINCK_SRC_RC
		choice
			prompt "RC oscillator frequency"

			config PMC_MAINCK_RC_FREQ_4MHZ
				bool "4 MHz"

			config PMC_MAINCK_RC_FREQ_8MHZ
				bool "8 MHz"

			config PMC_MAINCK_RC_FREQ_12MHZ
				bool "12 MHz"
		endchoice
	endif # PMC_MAINCK_SRC_RC

	# crystal oscillator
	if PMC_MAINCK_SRC_CRYSTAL
		config PMC_MAINCK_CRYSTAL_STARTUP
			int "Crystal oscillator startup time"
			range 1 255
			default 0
			help
				Number of SLCK cycles multiplied by 8
	endif # PMC_MAINCK_SRC_CRYSTAL

	menu "Hidden"
		visible if 0

		config PMC_MAINCK_SRC
			int "Main clock source"
			default 0 if PMC_MAINCK_SRC_RC
			default 1 if PMC_MAINCK_SRC_CRYSTAL

		config PMC_MAINCK_CRYSTAL_EN
			int "Crystal oscillator enable"
			default 1 if PMC_MAINCK_SRC_CRYSTAL
			default 0

		config PMC_MAINCK_RC_EN
			int "RC oscillator enable"
			default 1 if PMC_MAINCK_SRC_RC
			default 0

		config PMC_MAINCK_RC_FREQ
			int "RC oscillator frequency"
			default 0 if PMC_MAINCK_RC_FREQ_4MHZ
			default 1 if PMC_MAINCK_RC_FREQ_8MHZ
			default 2 if PMC_MAINCK_RC_FREQ_12MHZ
			default 2
	endmenu
endmenu
# }}}

#
# master and processor clock
#
# {{{
menu "Master (MCK), processor (HCLK) and SysTick clocks"
	choice
		prompt "Clock source"
		help
			Input clock to the master clock controller.

		config PMC_HCLK_SRC_SLCK
			bool "Slow clock (SLCK)"

		config PMC_HCLK_SRC_MAINCK
			bool "Main clock (MAINCK)"

		config PMC_HCLK_SRC_PLLACK
			bool "PLLA (PLLACK)"
			select PMC_PLLA_EN

		config PMC_HCLK_SRC_UPLLCKDIV
			bool "UPLLDIV (UPLLCKDIV)"
			select PMC_UPLL_EN
endchoice

	choice
		prompt "Prescaler"
		help
			Divider applied to the input clock. The result is used as the processor
			clock (HCLK). Further, the result divided by 8 is used as the SysTick clock.

		config PMC_HCLK_PRES_1
			bool "/1"

		config PMC_HCLK_PRES_2
			bool "/2"

		config PMC_HCLK_PRES_3
			bool "/3"

		config PMC_HCLK_PRES_4
			bool "/4"

		config PMC_HCLK_PRES_8
			bool "/8"

		config PMC_HCLK_PRES_16
			bool "/16"

		config PMC_HCLK_PRES_32
			bool "/32"
	endchoice

	choice
		prompt "Master clock divider"
		help
			Divider applied to processor clock (HCLK). The result is used as the master
			clock (MCK).

		config PMC_HCLK_DIV_1
			bool "/1"

		config PMC_HCLK_DIV_2
			bool "/2"

		config PMC_HCLK_DIV_3
			bool "/3"

		config PMC_HCLK_DIV_4
			bool "/4"
	endchoice

	menu "Hidden"
		visible if 0

		config PMC_HCLK_SRC
			int "Clock source"
			default 0 if PMC_HCLK_SRC_SLCK
			default 1 if PMC_HCLK_SRC_MAINCK
			default 2 if PMC_HCLK_SRC_PLLACK
			default 3 if PMC_HCLK_SRC_UPLLCKDIV

		config PMC_HCLK_PRES
			int "Prescaler"
			default 0 if PMC_HCLK_PRES_1
			default 1 if PMC_HCLK_PRES_2
			default 2 if PMC_HCLK_PRES_4
			default 3 if PMC_HCLK_PRES_8
			default 4 if PMC_HCLK_PRES_16
			default 5 if PMC_HCLK_PRES_32
			default 6 if PMC_HCLK_PRES_64
			default 7 if PMC_HCLK_PRES_3

		config PMC_HCLK_DIV
			int "Master clock divider"
			default 0 if PMC_HCLK_DIV_1
			default 1 if PMC_HCLK_DIV_2
			default 2 if PMC_HCLK_DIV_4
			default 3 if PMC_HCLK_DIV_3
	endmenu
endmenu
# }}}

#
# PLLA
#
# {{{
menuconfig PMC_PLLA_EN
	bool "PLLA (PLLACK)"
	default 0

if PMC_PLLA_EN
	config PMC_PLLA_DIV
		int "PLLA divider"
		range 1 255
		default 0

	config PMC_PLLA_MUL
		int "PLLA multiplier"
		range 1 62
		default 0
endif
# }}}

#
# UPLL
#
# {{{
menuconfig PMC_UPLL_EN
	bool "UPLL (UPLLCK)"
	default 0

if PMC_UPLL_EN
	choice
		prompt "UPLL divider"
		help
			Divider applied to UPLLCK. The result is used as UPLLDIV

		config PMC_UPLL_DIV_1
			bool "/1"

		config PMC_UPLL_DIV_2
			bool "/2"
	endchoice

	menu "Hidden"
		visible if 0

		config PMC_UPLL_DIV
			int "UPLL divider"
			default 0 if PMC_UPLL_DIV_1
			default 1 if PMC_UPLL_DIV_2
	endmenu
endif
# }}}

#
# USB clock
#
# {{{
menuconfig PMC_USB_EN
	bool "USB clock"
	default 0

if PMC_USB_EN
	choice
		prompt "Clock source"

		config PMC_USB_SRC_PLLACK
			bool "PLLA (PLACK)"

		config PMC_USB_SRC_UPLLCKDIV
			bool "UPLLDIV (UPLLCKDIV)"
	endchoice

	config PMC_USB_DIV
		int "Divider"
		range 1 16
		default 0

	menu "Hidden"
		visible if 0

		config PMC_USB_SRC
			int "Clock source"
			default 0 if PMC_USB_SRC_PLLACK
			default 1 if PMC_USB_SRC_UPLLCKDIV
	endmenu
endif
# }}}

#
# programmable clocks
#
# {{{
menuconfig PMC_PCKx_EN
	bool "Programmable clocks (0..7)"
	default 0

if PMC_PCKx_EN
	choice
		prompt "Clock source"
		help
			Input clock to programmable clocks.

		config PMC_PCKx_SRC_SLCK
			bool "Slow clock (SLCK)"

		config PMC_PCKx_SRC_MAINCK
			bool "Main clock (MAINCK)"

		config PMC_PCKx_SRC_PLLACK
			bool "PLLA (PLLACK)"
			select PMC_PLLA_EN

		config PMC_PCKx_SRC_UPLLCKDIV
			bool "UPLLDIV (UPLLCKDIV)"
			select PMC_UPLL_EN

		config PMC_PCKx_SRC_MCK
			bool "Master clock (MCK)"

		config PMC_PCKx_SRC_AUDIO
			bool "Audio clock (AUDIOPLLCLK)"
	endchoice

	config PMC_PCKx_PRES
		int "Prescaler"
		range 1 256
		default 0

	menu "Hidden"
		visible if 0

		config PMC_PCKx_SRC
			int "Clock source"
			default 0 if PMC_PCKx_SRC_SLCK
			default 1 if PMC_PCKx_SRC_MAINCK
			default 2 if PMC_PCKx_SRC_PLLACK
			default 3 if PMC_PCKx_SRC_UPLLCKDIV
			default 4 if PMC_PCKx_SRC_MCK
			default 5 if PMC_PCKx_SRC_AUDIO
	endmenu
endif
# }}}
```

## arch/avr/Kconfig
```kconfig
#
# Copyright (C) 2016 Jan Nowotsch
# Author Jan Nowotsch	<jan.nowotsch@gmail.com>
#
# Released under the terms of the GNU GPL v2.0
#



#
# MCU
#
# {{{
choice
	prompt "target mcu"
		
	config ATMEGA1284P
		bool "atmega1284p"
		select AVR_ISA_AVR51
		select AVR_RAMPZ
		select AVR_ATMEGA
endchoice

menu "hidden"
	visible if 0

	config AVR_MCU
		string "mcu"
		default "atmega1284p" if ATMEGA1284P
		default "unknown mcu"

	config AVR_ISA_AVR4
		bool "avr4"

	config AVR_ISA_AVR51
		bool "avr51"

	config AVR_ISA
		string "isa"
		default "avr4"	if AVR_ISA_AVR4
		default "avr51"	if AVR_ISA_AVR51

	config AVR_RAMPZ
		bool "rampz"
		default n

	config AVR_ATMEGA
		bool "atmega mcu"
		default n

	config AVR_XMEGA
		bool "xmega mcu"
		default n
endmenu
# }}}

#
# sleep modes
#
# {{{
choice
	prompt "sleep mode"

	config SLEEPMODE_IDLE
		bool "idle"

	config SLEEPMODE_ADCNR
		bool "adc noice reduction"

	config SLEEPMODE_PWRDWN
		bool "power down"

	config SLEEPMODE_PWRSAVE
		bool "power save"

	config SLEEPMODE_STANDBY
		bool "standby"

	config SLEEPMODE_EXTSTANDBY
		bool "extended standby"
endchoice
# }}}

#
# debug
#
# {{{
menu Debugging
	config IOVERFLOW_DET
		bool "instruction overflow detection"
		default n
		help
			Trigger an exception if instructions are executed from unused
			parts of the flash memory.
endmenu
# }}}
```

## arch/x86/Kconfig
```kconfig
#
# Copyright (C) 2020 Jan Nowotsch
# Author Jan Nowotsch	<jan.nowotsch@gmail.com>
#
# Released under the terms of the GNU GPL v2.0
#



config X86_GCOV_HEAP_SIZE
	int "libgcov heap size"
	default 512

menu "x86emu"
	source arch/x86/emu/Kconfig
endmenu
```
