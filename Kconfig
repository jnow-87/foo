## arch/x86/emu/Kconfig
```kconfig
#
# Copyright (C) 2020 Jan Nowotsch
# Author Jan Nowotsch	<jan.nowotsch@gmail.com>
#
# Released under the terms of the GNU GPL v2.0
#



config X86EMU_KERNEL_IMAGE
	qstring "default kernel image"
	default "recent/kernel/kimg.elf"

config X86EMU_APP_BINARY
	qstring "default application binary"
	default "recent/init/init.elf"

config X86EMU_FS_EXPORT_ROOT
	qstring "directory to export the brickos file system to"
	default "recent/test/integration/brickos-fs-export"

config X86EMU_HW_PIPE_RD
	int "data pipe input fileno"
	default 17

config X86EMU_HW_PIPE_WR
	int "data pipe output fileno"
	default 18

config X86EMU_USR_PIPE_RD
	int "control pipe input fileno"
	default 19

config X86EMU_USR_PIPE_WR
	int "control pipe output fileno"
	default 20

config X86EMU_HW_SIG
	int "signal for hardware operations"
	range 34 64
	default 36

config X86EMU_USR_SIG
	int "signal for user operations"
	range 34 64
	default 34

config X86EMU_USIGNAL_SIG
	int "signal to implement the brickos usignal mechanism"
	range 34 64
	default 35

config X86EMU_CONT_SIG
	int "continue signal SIGCONT"
	default 18

config X86EMU_UART_SIG
	int "uart signal"
	default 10
```

## driver/Kconfig
```kconfig
#
# Copyright (C) 2016 Jan Nowotsch
# Author Jan Nowotsch	<jan.nowotsch@gmail.com>
#
# Released under the terms of the GNU GPL v2.0
#



source driver/loop/Kconfig
source driver/bme280/Kconfig
source driver/esp8266/Kconfig
source driver/mcp23017/Kconfig
source driver/ssd1306/Kconfig
source driver/x11/Kconfig

#
# interfaces
#

source driver/bridge/Kconfig
source driver/i2c/Kconfig
source driver/gpio/Kconfig
source driver/term/Kconfig
source driver/vram/Kconfig

#
# platform
#
menu "platform drivers (avr)"
	depends on AVR
	source driver/avr/Kconfig
endmenu

menu "platform drivers (x86)"
	depends on X86
	source driver/x86/Kconfig
endmenu

menu "hidden"
	visible if 0

	config DRIVER_UART
		bool "uart driver"
		select AVR_UART if AVR
		select X86_UART if X86
endmenu
```

## driver/avr/Kconfig
```kconfig
#
# Copyright (C) 2022 Jan Nowotsch
# Author Jan Nowotsch	<jan.nowotsch@gmail.com>
#
# Released under the terms of the GNU GPL v2.0
#


# eeprom
config AVR_EEPROM
	bool "eeprom driver"
	select KERNEL_DEVFS
	select KERNEL_INTTASK

config AVR_EEPROM_DEBUG
	bool "eeprom debug messages"
	depends on AVR_EEPROM && KERNEL_MSG_DEBUG
	default n

# gpio
config AVR_GPIO
	bool "gpio driver"
	select GPIO_INT_WIDTH_8

# i2c
config AVR_I2C
	bool "i2c driver"

# pwm
config AVR_PWM8
	bool "pwm (8 bit) driver"
	select KERNEL_DEVFS

config AVR_PWM16
	bool "pwm (16 bit) driver"
	select KERNEL_DEVFS

# spi
config AVR_SPI
	bool "spi driver"

config AVR_SPI_DEBUG
	bool "spi debug messages"
	depends on AVR_SPI && KERNEL_MSG_DEBUG
	default n

# uart
config AVR_UART
	bool "uart driver"
```

## driver/avr_uart/Kconfig
```kconfig
config DRIVER_AVR_UART
	bool "AVR uart driver"

config AVR_UART_BSIZE
	int "AVR uart buffer size"
	depends on DRIVER_AVR_UART
	default 16

config AVR_NUART
	int "Number of uarts"
	depends on DRIVER_AVR_UART
	range 1 2 if KERNEL_UART
	range 0 2
```

## driver/bme280/Kconfig
```kconfig
#
# Copyright (C) 2023 Jan Nowotsch
# Author Jan Nowotsch	<jan.nowotsch@gmail.com>
#
# Released under the terms of the GNU GPL v2.0
#



config DRIVER_BME280
	bool "bme280 i2c environment sensor"
	select KERNEL_DEVFS
	select DRIVER_I2C
```

## driver/bridge/Kconfig
```kconfig
#
# Copyright (C) 2021 Jan Nowotsch
# Author Jan Nowotsch	<jan.nowotsch@gmail.com>
#
# Released under the terms of the GNU GPL v2.0
#



menuconfig DRIVER_BRIDGE
	bool "bridge driver"
	select KERNEL_SIGNAL
	select KERNEL_INTTASK
	select SYS_RINGBUFFER

if DRIVER_BRIDGE
	config BRIDGE_UART_DEV
		bool "uART bridge device"

	config BRIDGE_UART_ITF
		bool "uART bridge interface"

	config BRIDGE_I2C_DEV
		bool "i2c bridge device"

	config BRIDGE_I2C_ITF
		bool "i2c bridge interface"

	config BRIDGE_I2C_INLINE_DATA
		int "i2c bridge inline data size [bytes]"
		range 1 128
		default 8
		depends on BRIDGE_I2C_DEV || BRIDGE_I2C_ITF

	config BRIDGE_RETRY_LIMIT
		int "number of tolerated errors before aborting a transmission"
		default 3

	config BRIDGE_DEBUG
		bool "enable debug messages"
		select KERNEL_LOG_DEBUG
		default n

	config BRIDGE_DEBUG_PROTOCOL
		bool "enable protocol debug messages"
		select BRIDGE_DEBUG
		default n
endif # DRIVER_BRIDGE
```

## driver/eeprom/Kconfig
```kconfig
#
# Copyright (C) 2019 Jan Nowotsch
# Author Jan Nowotsch	<jan.nowotsch@gmail.com>
#
# Released under the terms of the GNU GPL v2.0
#



menuconfig DRIVER_EEPROM
	bool "EEPROM driver"
	select KERNEL_DEVFS
	select KERNEL_SIGQUEUE

if DRIVER_EEPROM
	config EEPROM_DEBUG
		bool "Enable debug messages"
		depends on KERNEL_MSG_DEBUG
		default n
endif # DRIVER_EEPROM
```

## driver/esp8266/Kconfig
```kconfig
#
# Copyright (C) 2019 Jan Nowotsch
# Author Jan Nowotsch	<jan.nowotsch@gmail.com>
#
# Released under the terms of the GNU GPL v2.0
#



menuconfig DRIVER_ESP8266
	bool "esp8266 wlan driver"
	select KERNEL_NET
	select KERNEL_SIGNAL
	select KERNEL_INTTASK
	select SYS_PATTERN_MATCH
	select DRIVER_UART

if DRIVER_ESP8266
	config ESP8266_LINK_COUNT
		int "number of supported links"
		default 5

	config ESP8266_DEBUG
		bool "enable debug messages"
		depends on KERNEL_MSG_DEBUG
		default n
endif # DRIVER_ESP8266
```

## driver/gpio/Kconfig
```kconfig
#
# Copyright (C) 2018 Jan Nowotsch
# Author Jan Nowotsch	<jan.nowotsch@gmail.com>
#
# Released under the terms of the GNU GPL v2.0
#



menuconfig DRIVER_GPIO
	bool "gpio driver"
	select KERNEL_DEVFS
	select SC_SIGNAL
	select AVR_GPIO if AVR
	select RP2040_GPIO if ARM_CHIP_RP2040
	select X86_GPIO if X86

if DRIVER_GPIO
	config GPIO_PIN
		bool "pin device support"
		default n

	config GPIO_PORT
		bool "port device support"
		default y

	config GPIO_INTFWD
		bool "interrupt forwarding support"
		default n

	config GPIO_DEBUG
		bool "enable debug messages"
		select KERNEL_LOG_DEBUG
		default n

	menu "hidden"
		visible if 0

		config GPIO_INT_WIDTH_8
			bool "8 bit"

		config GPIO_INT_WIDTH_16
			bool "16 bit"

		config GPIO_INT_WIDTH_32
			bool "32 bit"

		config GPIO_INT_WIDTH_64
			bool "64 bit"

		config GPIO_INT_WIDTH
			int "gpio register width"
			default 8	if GPIO_INT_WIDTH_8
			default 16	if GPIO_INT_WIDTH_16
			default 32	if GPIO_INT_WIDTH_32
			default 64	if GPIO_INT_WIDTH_64
	endmenu
endif # DRIVER_GPIO
```

## driver/i2c/Kconfig
```kconfig
#
# Copyright (C) 2019 Jan Nowotsch
# Author Jan Nowotsch	<jan.nowotsch@gmail.com>
#
# Released under the terms of the GNU GPL v2.0
#



menuconfig DRIVER_I2C
	bool "i2c driver"
	select AVR_I2C if AVR
	select X86_I2C if X86

if DRIVER_I2C
	config I2C_RAW
		bool "raw i2c device"
		select KERNEL_DEVFS
		default n

	config I2C_RXBUF_SIZE
		int "rx buffer size"
		default 16

	config I2C_DEBUG
		bool "i2c debug messages"
		depends on DRIVER_I2C
		select KERNEL_LOG_DEBUG
		default n
endif # DRIVER_I2C
```

## driver/i2c/avr/Kconfig
```kconfig
#
# Copyright (C) 2019 Jan Nowotsch
# Author Jan Nowotsch	<jan.nowotsch@gmail.com>
#
# Released under the terms of the GNU GPL v2.0
#



config I2C_AVR_INTERRUPT
	bool "Interrupt support"
	default y

config I2C_AVR_POLLING
	bool "Polling support"
	default n
```

## driver/loop/Kconfig
```kconfig
#
# Copyright (C) 2017 Jan Nowotsch
# Author Jan Nowotsch	<jan.nowotsch@gmail.com>
#
# Released under the terms of the GNU GPL v2.0
#



menuconfig DRIVER_LOOPBACK
	bool "loopback"

if DRIVER_LOOPBACK
	config LOOP_BLOCK
		bool "loopback block device"
		select KERNEL_DEVFS

	config LOOP_TERM
		bool "loopback terminal"
		select SYS_RINGBUFFER

	config LOOP_VRAM
		bool "loopback video ram"
		select KERNEL_DEVFS

	config LOOP_DEBUG
		bool "enable debug messages"
		select KERNEL_LOG_DEBUG
		default n
endif # DRIVER_LOOPBACK
```

## driver/mcp23017/Kconfig
```kconfig
#
# Copyright (C) 2022 Jan Nowotsch
# Author Jan Nowotsch	<jan.nowotsch@gmail.com>
#
# Released under the terms of the GNU GPL v2.0
#



config DRIVER_MCP23017
	bool "mcp23017 i2c i/o expander"
	select DRIVER_I2C
	select DRIVER_GPIO
```

## driver/pwm/Kconfig
```kconfig
#
# Copyright (C) 2019 Jan Nowotsch
# Author Jan Nowotsch	<jan.nowotsch@gmail.com>
#
# Released under the terms of the GNU GPL v2.0
#



menuconfig DRIVER_PWM
	bool "PWM driver"
	select KERNEL_DEVFS

if DRIVER_PWM
	if AVR
		config AVR_PWM_8BIT
			bool "8 bit timer support"

		config AVR_PWM_16BIT
			bool "16 bit timer support"
	endif # AVR

	config PWM_DEBUG
		bool "Enable debug messages"
		depends on KERNEL_MSG_DEBUG
		default n
endif # DRIVER_PWM
```

## driver/rp2040/Kconfig
```kconfig
#
# Copyright (C) 2024 Jan Nowotsch
# Author Jan Nowotsch	<jan.nowotsch@gmail.com>
#
# Released under the terms of the GNU GPL v2.0
#


# gpio
config RP2040_GPIO
	bool "gpio driver"
	select GPIO_INT_WIDTH_32

# uart
config RP2040_UART
	bool "uart driver"
```

## driver/spi/Kconfig
```kconfig
#
# Copyright (C) 2019 Jan Nowotsch
# Author Jan Nowotsch	<jan.nowotsch@gmail.com>
#
# Released under the terms of the GNU GPL v2.0
#



menuconfig DRIVER_SPI
	bool "SPI driver"
	select KERNEL_DEVFS

if DRIVER_SPI
	config SPI_DEBUG
		bool "Enable debug messages"
		depends on KERNEL_MSG_DEBUG
		default n
endif # DRIVER_SPI
```
